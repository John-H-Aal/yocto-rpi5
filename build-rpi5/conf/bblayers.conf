## build-rpi5/conf/bblayers.conf
```bitbake
# POKY_BBLAYERS_CONF_VERSION is increased each time build/conf/bblayers.conf
# changes incompatibly
POKY_BBLAYERS_CONF_VERSION = "2"

BBPATH = "${TOPDIR}"
BBFILES ?= ""

BBLAYERS ?= " \
  /home/john/repos/yocto-rpi5/poky/meta \
  /home/john/repos/yocto-rpi5/poky/meta-poky \
  /home/john/repos/yocto-rpi5/poky/meta-yocto-bsp \
  /home/john/repos/yocto-rpi5/meta-openembedded/meta-oe \
  /home/john/repos/yocto-rpi5/meta-openembedded/meta-python \
  /home/john/repos/yocto-rpi5/meta-openembedded/meta-networking \
  /home/john/repos/yocto-rpi5/meta-lts-mixins \
  /home/john/repos/yocto-rpi5/meta-raspberrypi \
  /home/john/repos/yocto-rpi5/meta-rauc \
  /home/john/repos/yocto-rpi5/meta-rauc-community/meta-rauc-raspberrypi \
  /home/john/repos/yocto-rpi5/meta-john \
  "
```
